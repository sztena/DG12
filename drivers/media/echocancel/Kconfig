## drivers/media/echocancel/Kconfig
```kconfig
#
# Multimedia Video device configuration
#

menuconfig ECHO_CANCEL
	bool "Echo Cancellation"
#	depends on 
	default y
	---help---
	  Say Y here to enable selecting AM/FM radio adapters.

if ECHO_CANCEL

config ECHOCANCEL_FM2018
	tristate "fortemedia FM2018-380"
#	depends on 
	---help---
	  Choose Y here if you have one of these AM/FM radio cards, and then
	  fill in the port address below.

	  In order to control your radio card, you will need to use programs
	  that are compatible with the Video For Linux API.  Information on
	  this API and pointers to "v4l" programs may be found at
	  <file:Documentation/video4linux/API.html>.

	  Further documentation on this driver can be found on the WWW at
	  <http://linux.blackhawke.net/cadet/>.

	  To compile this driver as a module, choose M here: the
	  module will be called radio-cadet.

endif # ECHO_CANCEL
```
